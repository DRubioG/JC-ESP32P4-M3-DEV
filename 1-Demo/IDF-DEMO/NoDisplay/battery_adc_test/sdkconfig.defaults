## 1-Demo/IDF-DEMO/withDisplay/lvgl_sw_rotation/main/Kconfig.projbuild
```kconfig
menu "Example Configuration"
    menu "Touch Controller"
        config EXAMPLE_LCD_TOUCH_CONTROLLER_GT911
            bool "Enable LCD GT911 Touch"
            default n
            help
                Enable this option if you wish to use display touch.
    endmenu
    menu "Display"
        config EXAMPLE_LVGL_PORT_TASK_MAX_DELAY_MS
            int "LVGL timer task maximum delay (ms)"
            default 500
            range 2 2000  # Example range, adjust as needed
            help
            The maximum delay of the LVGL timer task, in milliseconds.

        config EXAMPLE_LVGL_PORT_TASK_MIN_DELAY_MS
            int "LVGL timer task minimum delay (ms)"
            default 5
            range 1 100  # Example range, adjust as needed
            help
            The minimum delay of the LVGL timer task, in milliseconds.

        config EXAMPLE_LVGL_PORT_TASK_PRIORITY
            int "LVGL task priority"
            default 4
            help
                The Board Support Package will create a task that will periodically handle LVGL operation in lv_timer_handler().

        config EXAMPLE_LVGL_PORT_TASK_STACK_SIZE_KB
            int "LVGL task stack size (KB)"
            default 6
            help
                Size(KB) of LVGL task stack.

        config EXAMPLE_LVGL_PORT_TASK_CORE
            int "LVGL timer task core"
            default -1
            range -1 1
            help
            The core of the LVGL timer task.
            Set to -1 to not specify the core.
            Set to 1 only if the SoCs support dual-core, otherwise set to -1 or 0.

        config EXAMPLE_LVGL_PORT_TICK
            int "LVGL tick period"
            default 2
            range 1 100
            help
                Period of LVGL tick timer.

        config EXAMPLE_LVGL_PORT_AVOID_TEAR_ENABLE
            bool "Avoid tearing effect"
            default "n"
            help
                Avoid tearing effect through LVGL buffer mode and double frame buffers of RGB LCD. This feature is only available for RGB LCD.

        choice
            depends on EXAMPLE_LVGL_PORT_AVOID_TEAR_ENABLE
            prompt "Select Avoid Tearing Mode"
            default EXAMPLE_LVGL_PORT_AVOID_TEAR_MODE_3
            config EXAMPLE_LVGL_PORT_AVOID_TEAR_MODE_1
                bool "Mode1: LCD double-buffer & LVGL full-refresh"
            config EXAMPLE_LVGL_PORT_AVOID_TEAR_MODE_2
                bool "Mode2: LCD triple-buffer & LVGL full-refresh"
            config EXAMPLE_LVGL_PORT_AVOID_TEAR_MODE_3
                bool "Mode3: LCD double-buffer & LVGL direct-mode"
            help
                The current tearing prevention mode supports both full refresh mode and direct mode. Tearing prevention mode may consume more PSRAM space
        endchoice

        config EXAMPLE_LVGL_PORT_AVOID_TEAR_MODE
            depends on EXAMPLE_LVGL_PORT_AVOID_TEAR_ENABLE
            int
            default 1 if EXAMPLE_LVGL_PORT_AVOID_TEAR_MODE_1
            default 2 if EXAMPLE_LVGL_PORT_AVOID_TEAR_MODE_2
            default 3 if EXAMPLE_LVGL_PORT_AVOID_TEAR_MODE_3

        choice
            depends on EXAMPLE_LVGL_PORT_AVOID_TEAR_ENABLE
            prompt "Select rotation"
            default EXAMPLE_LVGL_PORT_ROTATION_0
            config EXAMPLE_LVGL_PORT_ROTATION_0
                bool "Rotation 0"
            config EXAMPLE_LVGL_PORT_ROTATION_90
                bool "Rotation 90"
            config EXAMPLE_LVGL_PORT_ROTATION_180
                bool "Rotation 180"
            config EXAMPLE_LVGL_PORT_ROTATION_270
                bool "Rotation 270"
        endchoice

        config EXAMPLE_LVGL_PORT_PPA_ROTATION_ENABLE
            depends on EXAMPLE_LVGL_PORT_AVOID_TEAR_ENABLE && IDF_TARGET_ESP32P4 && !EXAMPLE_LVGL_PORT_ROTATION_0
            bool "Enable PPA Rotation"
            default n
            help
                Enable this option to use PPA (Pixel Processor Assembly) for display rotation.
                This feature allows hardware-based rotation for improved performance

        config EXAMPLE_LVGL_PORT_ROTATION_DEGREE
            int
            default 0 if EXAMPLE_LVGL_PORT_ROTATION_0
            default 90 if EXAMPLE_LVGL_PORT_ROTATION_90
            default 180 if EXAMPLE_LVGL_PORT_ROTATION_180
            default 270 if EXAMPLE_LVGL_PORT_ROTATION_270

        choice
            depends on !EXAMPLE_LVGL_PORT_AVOID_TEAR_ENABLE
            prompt "Select LVGL buffer memory capability"
            default EXAMPLE_LVGL_PORT_BUF_PSRAM
            config EXAMPLE_LVGL_PORT_BUF_PSRAM
                bool "PSRAM memory"
        endchoice

        config EXAMPLE_LVGL_PORT_BUF_HEIGHT
            depends on !EXAMPLE_LVGL_PORT_AVOID_TEAR_ENABLE
            int "LVGL buffer height"
            default 100
            help
                Height of LVGL buffer. The width of the buffer is the same as that of the LCD.
    endmenu
    # menu "camer"

    #     config EXAMPLE_ENABLE_MIPI_CSI_CAM_SENSOR
    #         bool "Enable MIPI CSI Camera Sensor"
    #         default y
    #         depends on SOC_MIPI_CSI_SUPPORTED
    
    #     if EXAMPLE_ENABLE_MIPI_CSI_CAM_SENSOR
    #         config EXAMPLE_MIPI_CSI_SCCB_I2C_PORT
    #             int "MIPI CSI SCCB I2C Port Number"
    #             default 0
    #             range 0 1
    
    #         config EXAMPLE_MIPI_CSI_SCCB_I2C_SCL_PIN
    #             int "MIPI CSI SCCB I2C SCL Pin"
    #             default 34
    #             range -1 56
    
    #         config EXAMPLE_MIPI_CSI_SCCB_I2C_SDA_PIN
    #             int "MIPI CSI SCCB I2C SDA Pin"
    #             default 31
    #             range -1 56
    
    #         config EXAMPLE_MIPI_CSI_SCCB_I2C_FREQ
    #             int "MIPI CSI SCCB I2C Frequency"
    #             default 100000
    #             range 100000 400000
    #             help
    #                 Increasing this value can reduce the initialization time of the camera sensor.
    #                 Please refer to the relevant instructions of the camera sensor to adjust the value.
    
    #         config EXAMPLE_MIPI_CSI_CAM_SENSOR_RESET_PIN
    #             int "MIPI CSI Camera Sensor Reset Pin"
    #             default -1
    #             range -1 56
    
    #         config EXAMPLE_MIPI_CSI_CAM_SENSOR_PWDN_PIN
    #             int "MIPI CSI Camera Sensor Power Down Pin"
    #             default -1
    #             range -1 56
    #     endif
    
    #     config EXAMPLE_ENABLE_PRINT_FPS_RATE_VALUE
    #         bool "enable print fps rate value"
    #         default y
    
    #     config EXAMPLE_USE_MEMORY_MAPPING
    #         bool "Use Memory Mapping for Buffer Allocation"
    #         default n
    #         help
    #         Enable this option if you want to allocate memory using memory mapping.
    #         This is typically useful for performance optimization or when working
    #         with hardware that requires mapped memory access
    
    #     config EXAMPLE_CAM_BUF_COUNT
    #         int "Camera Buffer Count"
    #         default 2
    #         range 2 3
    
    #     choice
    #         prompt "Choose the color format of the LCD"
    #         default LCD_PIXEL_FORMAT_RGB565
    #             config LCD_PIXEL_FORMAT_RGB565
    #                 bool "RGB565"
    
    #             config LCD_PIXEL_FORMAT_RGB888
    #                 bool "RGB888"
    #     endchoice
    
    #     config EXAMPLE_ENABLE_CAM_SENSOR_PIC_VFLIP
    #         bool "Enable Camera Sensor Picture Vertical Flip"
    #         default y
    #         help
    #             Select this option, enable camera sensor picture vertical flip.
    
    #     config EXAMPLE_ENABLE_CAM_SENSOR_PIC_HFLIP
    #         bool "Enable Camera Sensor Picture Horizontal Flip"
    #         default y
    #         help
    #             Select this option, enable camera sensor picture horizontal flip.
    # endmenu
endmenu
```

## 1-Demo/IDF-DEMO/withDisplay/test/main/Kconfig.projbuild
```kconfig
menu "Example EthToAP Configuration"

    config EXAMPLE_WIFI_SSID
        string "Wi-Fi SSID"
        default "eth2ap"
        help
            Set the SSID of Wi-Fi ap interface.

    config EXAMPLE_WIFI_PASSWORD
        string "Wi-Fi Password"
        default "12345678"
        help
            Set the password of Wi-Fi ap interface.

    config EXAMPLE_WIFI_CHANNEL
        int "WiFi channel"
        range 1 13
        default 1
        help
            Set the channel of Wi-Fi ap.

    config EXAMPLE_MAX_STA_CONN
        int "Maximum STA connections"
        default 4
        help
            Maximum number of the station that allowed to connect to current Wi-Fi hotspot.

endmenu

menu "Example CAM Configuration"

    config EXAMPLE_ENABLE_MIPI_CSI_CAM_SENSOR
        bool "Enable MIPI CSI Camera Sensor"
        default y
        depends on ESP_VIDEO_ENABLE_MIPI_CSI_VIDEO_DEVICE

    if EXAMPLE_ENABLE_MIPI_CSI_CAM_SENSOR
        config EXAMPLE_MIPI_CSI_SCCB_I2C_PORT
            int "MIPI CSI SCCB I2C Port Number"
            default 0
            range 0 1

        config EXAMPLE_MIPI_CSI_SCCB_I2C_SCL_PIN
            int "MIPI CSI SCCB I2C SCL Pin"
            default 8
            range -1 56

        config EXAMPLE_MIPI_CSI_SCCB_I2C_SDA_PIN
            int "MIPI CSI SCCB I2C SDA Pin"
            default 7
            range -1 56

        config EXAMPLE_MIPI_CSI_SCCB_I2C_FREQ
            int "MIPI CSI SCCB I2C Frequency"
            default 100000
            range 100000 400000
            help
                Increasing this value can reduce the initialization time of the camera sensor.
                Please refer to the relevant instructions of the camera sensor to adjust the value.

        config EXAMPLE_MIPI_CSI_CAM_SENSOR_RESET_PIN
            int "MIPI CSI Camera Sensor Reset Pin"
            default -1
            range -1 56

        config EXAMPLE_MIPI_CSI_CAM_SENSOR_PWDN_PIN
            int "MIPI CSI Camera Sensor Power Down Pin"
            default -1
            range -1 56
    endif

    config EXAMPLE_ENABLE_DVP_CAM_SENSOR
        bool "Enable DVP Camera Sensor"
        default n
        depends on ESP_VIDEO_ENABLE_DVP_VIDEO_DEVICE

    if EXAMPLE_ENABLE_DVP_CAM_SENSOR
        config EXAMPLE_DVP_SCCB_I2C_PORT
            int "DVP SCCB I2C Port Number"
            default 1
            range 0 1

        config EXAMPLE_DVP_SCCB_I2C_SCL_PIN
            int "DVP SCCB I2C SCL Pin"
            default 33
            range -1 56

        config EXAMPLE_DVP_SCCB_I2C_SDA_PIN
            int "DVP SCCB I2C SDA Pin"
            default 32
            range -1 56

        config EXAMPLE_DVP_SCCB_I2C_FREQ
            int "DVP SCCB I2C Frequency"
            default 100000
            range 100000 400000
            help
                Increasing this value can reduce the initialization time of the camera sensor.
                Please refer to the relevant instructions of the camera sensor to adjust the value.

        config EXAMPLE_DVP_CAM_SENSOR_RESET_PIN
            int "DVP Camera Sensor Reset Pin"
            default -1
            range -1 56

        config EXAMPLE_DVP_CAM_SENSOR_PWDN_PIN
            int "DVP Camera Sensor Power Down Pin"
            default -1
            range -1 56

        config EXAMPLE_DVP_XCLK_FREQ
            int "DVP XCLK Frequency"
            default 20000000

        config EXAMPLE_DVP_XCLK_PIN
            int "DVP XCLK Pin"
            range 0 56
            default 20

        config EXAMPLE_DVP_PCLK_PIN
            int "DVP PCLK Pin"
            range 0 56
            default 21

        config EXAMPLE_DVP_VSYNC_PIN
            int "DVP VSYNC Pin"
            range 0 56
            default 23

        config EXAMPLE_DVP_DE_PIN
            int "DVP DE Pin"
            range 0 56
            default 22

        config EXAMPLE_DVP_D0_PIN
            int "DVP D0 Pin"
            range 0 56
            default 53

        config EXAMPLE_DVP_D1_PIN
            int "DVP D1 Pin"
            range 0 56
            default 54

        config EXAMPLE_DVP_D2_PIN
            int "DVP D2 Pin"
            range 0 56
            default 52

        config EXAMPLE_DVP_D3_PIN
            int "DVP D3 Pin"
            range 0 56
            default 1

        config EXAMPLE_DVP_D4_PIN
            int "DVP D4 Pin"
            range 0 56
            default 0

        config EXAMPLE_DVP_D5_PIN
            int "DVP D5 Pin"
            range 0 56
            default 45

        config EXAMPLE_DVP_D6_PIN
            int "DVP D6 Pin"
            range 0 56
            default 46

        config EXAMPLE_DVP_D7_PIN
            int "DVP D7 Pin"
            range 0 56
            default 47
    endif

endmenu
```
